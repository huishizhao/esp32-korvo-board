## KConfig.projbuild
```kconfig
menu "Audio HAL"

  choice CUSTOM_AUDIO_BOARD
      prompt "Custom Audio Board"
      default ESP32_KORVO_V1_BOARD
      help
          Select an audio board to use with the ESP-ADF
  config ESP32_KORVO_V1_BOARD
      bool "ESP32_Korvo_v1"

  endchoice

  endmenu
```
